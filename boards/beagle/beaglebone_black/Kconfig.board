## boards/beagle/beaglebone_black/Kconfig.board
```kconfig
# SPDX-License-Identifier: Apache-2.0

config BOARD_BEAGLEBONE_BLACK
	bool "BeagleBone Black"
	depends on SOC_AM3358
	select SOC_SERIES_AM335X
```

## boards/beagle/beaglebone_black/Kconfig.defconfig
```kconfig
# SPDX-License-Identifier: Apache-2.0

if BOARD_BEAGLEBONE_BLACK

config BOARD
	default "beaglebone_black"

config CONSOLE
	default y

config UART_CONSOLE
	default y

config SERIAL
	default y

config GPIO
	default y

config GPIO_AM335X
	bool
	default y if GPIO

config UART_AM335X
	bool
	default y if SERIAL

# Pin control
config PINCTRL
	bool
	default y

config PINCTRL_AM335X
	bool
	default y if PINCTRL



endif # BOARD_BEAGLEBONE_BLACK
```

## boards/beagle/beaglebone_black/beaglebone_black_defconfig
```kconfig
# SPDX-License-Identifier: Apache-2.0
# Copyright (c) 2025 Rajeev H
#
# BeagleBone Black Board Configuration
# TI AM335x (Cortex-A8) - DDR RAM execution

# SoC Configuration
CONFIG_SOC_SERIES_AM335X=y
CONFIG_SOC_AM335X=y

# Memory Configuration
CONFIG_XIP=n
CONFIG_SRAM_BASE_ADDRESS=0x80000000
CONFIG_SRAM_SIZE=262144

# Disable MMU for simpler configuration


# Console and Serial
CONFIG_CONSOLE=y
CONFIG_UART_CONSOLE=y
CONFIG_SERIAL=y
CONFIG_PRINTK=y
CONFIG_EARLY_CONSOLE=y

# GPIO
CONFIG_GPIO=y

# Pin Control
CONFIG_PINCTRL=y

# Timer (System Clock)
CONFIG_AM335X_TIMER=y
CONFIG_SYS_CLOCK_EXISTS=y
CONFIG_SYS_CLOCK_TICKS_PER_SEC=100
CONFIG_TICKLESS_KERNEL=y

# Interrupt Controller
# Note: Interrupt controller is built into SoC code, no separate config needed

# Stack Sizes
CONFIG_MAIN_STACK_SIZE=4096
CONFIG_IDLE_STACK_SIZE=1024
CONFIG_ISR_STACK_SIZE=2048
CONFIG_THREAD_STACK_INFO=y

# Memory Pool
CONFIG_HEAP_MEM_POOL_SIZE=131072

# System initialization
CONFIG_SYSTEM_WORKQUEUE_STACK_SIZE=2048

# Kernel Options
CONFIG_KERNEL_ENTRY="__start"
CONFIG_KERNEL_BIN_NAME="zephyr"

# Boot Options
CONFIG_BOOT_BANNER=y
CONFIG_BOOT_DELAY=0


# Build Options
CONFIG_SIZE_OPTIMIZATIONS=n

CONFIG_GEN_ISR_TABLES=y
CONFIG_DYNAMIC_INTERRUPTS=y

CONFIG_INTC_AM335X=y

# Cortex-A uses static vector table
CONFIG_GEN_ISR_TABLES=n
CONFIG_IRQ_OFFLOAD=n
CONFIG_DYNAMIC_INTERRUPTS=n

# Required for Cortex-A
CONFIG_MULTI_LEVEL_INTERRUPTS=n
```

## boards/beagle/beaglebone_black/board.yml
```yaml
# Copyright (c) 2025 Rajeev H
# SPDX-License-Identifier: Apache-2.0

board:
  name: beaglebone_black
  full_name: BeagleBone Black
  vendor: beagle
  socs:
  - name: am335x
```

## drivers/gpio/Kconfig.am335x
```kconfig
# SPDX-License-Identifier: Apache-2.0

config GPIO_AM335X
	bool "AM335x GPIO driver"
	default y
	depends on DT_HAS_AM335x_GPIO_ENABLED
	select MFD
	help
	  Enable the AM335X GPIO driver.
```

## drivers/interrupt_controller/Kconfig.am335x
```kconfig
config INTC_AM335X
	bool "TI AM335x Interrupt Controller"
	default y
	depends on ARM && CPU_CORTEX_A8
	help
	  Enable interrupt controller driver for TI AM335x SoCs.
```

## drivers/pinctrl/Kconfig.am335x
```kconfig
# SPDX-License-Identifier: Apache-2.0
#

config PINCTRL_AM335X
	bool "TI AM335x pinctrl driver"
	default y
	depends on DT_HAS_TI_AM335X_PINCTRL_ENABLED
	help
	  Enable pin control driver for TI AM335x SoC series.
	  This driver provides:
	  - Pin multiplexing (8 modes per pin)
	  - Pull-up/pull-down resistor control
	  - Input enable control
	  - Slew rate control

	  The driver allows configuration of the AM335x control
	  module registers to properly route signals to external
	  pins and configure electrical properties.
```

## drivers/serial/Kconfig.am335x
```kconfig
config UART_AM335X
	bool "TI AM335x UART driver"
	default y
	depends on DT_HAS_TI_AM335X_UART_ENABLED
	depends on SERIAL
	select SERIAL_HAS_DRIVER
	help
	  Enable polling-only UART driver for TI AM335x SoC
```

## drivers/timer/Kconfig.am335x
```kconfig
# SPDX-License-Identifier: Apache-2.0
#

config AM335X_TIMER
	bool "TI AM335x DMTimer driver"
	default y
	depends on DT_HAS_TI_AM335X_TIMER_ENABLED
	select TICKLESS_CAPABLE
	help
	  Enable DMTimer driver for TI AM335x SoC series.
	  This driver provides:
	  - System clock source
	  - Tickless kernel support
	  - 32-bit counter
	  - Match and overflow interrupts
	  - Up to 8 timer modules (DMTIMER0-7)
```

## dts/bindings/gpio/ti,am335x-gpio.yaml
```yaml
# SPDX-License-Identifier: Apache-2.0
# File #15: dts/bindings/gpio/ti,am335x-gpio.yaml

description: TI AM335x GPIO controller

compatible: "ti,am335x-gpio"

include: [gpio-controller.yaml, base.yaml, pinctrl-device.yaml]

properties:
  reg:
    required: true

  interrupts:
    required: true

  ngpios:
    type: int
    required: true
    description: Number of GPIOs (typically 32)

gpio-cells:
  - pin
  - flags
```

## dts/bindings/interrupt-controller/ti,am335x-intc.yaml
```yaml
# SPDX-License-Identifier: Apache-2.0

description: TI AM335x Interrupt Controller (INTC)

compatible: "ti,am335x-intc"

include: interrupt-controller.yaml

properties:
  reg:
    type: array
    required: true

  "#interrupt-cells":
    type: int
    const: 1

interrupt-cells:
  - irq
```

## dts/bindings/pinctrl/ti,am335x-pinctrl.yaml
```yaml
# SPDX-License-Identifier: Apache-2.0

description: TI AM335x Pin Controller

compatible: "ti,am335x-pinctrl"

include: base.yaml

child-binding:
  description: |
    Pin configuration for AM335x.

    Each pin is configured with an offset and configuration bits.

  properties:
    pinmux:
      required: true
      type: array
      description: |
        Pin mux configuration array. Each entry contains:
        - Pin offset (bits 15:0)
        - Mux mode (bits 18:16)
        - Pull disable (bit 19)
        - Pull type (bit 20): 0=pulldown, 1=pullup
        - Input enable (bit 21)
        - Slew control (bit 22)
```

## dts/bindings/serial/ti,am335x-uart.yaml
```yaml
# SPDX-License-Identifier: Apache-2.0

description: TI AM335x UART controller

compatible: "ti,am335x-uart"

include: [uart-controller.yaml, base.yaml, pinctrl-device.yaml]

properties:
  reg:
    required: true

  interrupts:
    required: true

  current-speed:
    type: int
    required: true
    description: Initial baud rate setting for UART
```

## dts/bindings/timer/ti,am335x-timer.yaml
```yaml
# SPDX-License-Identifier: Apache-2.0

description: TI AM335x DMTimer controller

compatible: "ti,am335x-timer"

include: base.yaml

properties:
  reg:
    required: true

  interrupts:
    required: true
```

## soc/ti/am335x/Kconfig.defconfig
```kconfig
# SPDX-License-Identifier: Apache-2.0

if SOC_SERIES_AM335X

config SOC_SERIES
	default "am335x"

config SYS_CLOCK_HW_CYCLES_PER_SEC
	default 24000000

config SOC_FAMILY
	default "ti"

config SOC_FAMILY_TI
	bool
	default y

endif # SOC_SERIES_AM335X
```

## soc/ti/am335x/Kconfig.soc
```kconfig
# SPDX-License-Identifier: Apache-2.0

config SOC_SERIES_AM335X
	bool "TI AM335x Series"
	select ARM
	select CPU_CORTEX_A8
	select ARM_ARCH_TIMER if SYS_CLOCK_EXISTS
	help
	  Enable support for TI AM335x SoC series

config SOC_AM3358
	bool "AM3358 SoC"
	select SOC_SERIES_AM335X
	help
	  Enable support for TI AM3358 SoC (BeagleBone Black)

config SOC
	default "am3358" if SOC_AM3358

config SOC_SERIES
	default "am335x" if SOC_SERIES_AM335X

config NUM_IRQS
	default 128 if SOC_SERIES_AM335X

config SYS_CLOCK_HW_CYCLES_PER_SEC
	default 24000000 if SOC_SERIES_AM335X

config FLASH_SIZE
	default 0

config FLASH_BASE_ADDRESS
	default 0x80000000 if SOC_SERIES_AM335X

config SRAM_SIZE
	default 512 if SOC_SERIES_AM335X

config SRAM_BASE_ADDRESS
	default 0x80000000 if SOC_SERIES_AM335X
```
